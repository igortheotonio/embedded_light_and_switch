## boards/arm/led_light_p1/Kconfig
```kconfig
# Kconfig - LED LIGHT P1 board configuration
#
# Copyright (c) 2016 Nordic Semiconductor ASA
#
# SPDX-License-Identifier: Apache-2.0

if BOARD_LED_LIGHT_P1

config BOARD_ENABLE_DCDC
	bool "Enable DCDC mode"
	select SOC_DCDC_NRF52X
	default y

endif # BOARD_LED_LIGHT_P1
```

## boards/arm/led_light_p1/Kconfig.board
```kconfig
# Kconfig - nRF52 LED LIGHT board configuration
#
# Copyright (c) 2016 Nordic Semiconductor ASA
#
# SPDX-License-Identifier: Apache-2.0

config  BOARD_LED_LIGHT_P1
	bool "LED_LIGHT_P1"
	depends on SOC_NRF52832_QFAA
```

## boards/arm/light_switch_p1/Kconfig
```kconfig
# Kconfig - nRF52 SWITCH LIGHT board configuration
#
# Copyright (c) 2016 Nordic Semiconductor ASA
#
# SPDX-License-Identifier: Apache-2.0

if BOARD_LIGHT_SWITCH_P1

config BOARD_ENABLE_DCDC
	bool "Enable DCDC mode"
	select SOC_DCDC_NRF52X
	default y

endif # BOARD_LIGHT_SWITCH_P1
```

## boards/arm/light_switch_p1/Kconfig.board
```kconfig
# Kconfig - nRF52 Light Switch board configuration
#
# Copyright (c) 2016 Nordic Semiconductor ASA
#
# SPDX-License-Identifier: Apache-2.0

config  BOARD_LIGHT_SWITCH_P1
	bool "LIGHT_SWITCH_P1"
	depends on SOC_NRF52832_QFAA
```

## boards/arm/nrf52_led_light/Kconfig
```kconfig
# Kconfig - nRF52 LED LIGHT board configuration
#
# Copyright (c) 2016 Nordic Semiconductor ASA
#
# SPDX-License-Identifier: Apache-2.0

if BOARD_NRF52_LED_LIGHT

config BOARD_ENABLE_DCDC
	bool "Enable DCDC mode"
	select SOC_DCDC_NRF52X
	default y

endif # BOARD_NRF52_LED_LIGHT
```

## boards/arm/nrf52_led_light/Kconfig.defconfig
```kconfig
# Kconfig - nRF52 PCA10040 board configuration
#
# Copyright (c) 2016 Nordic Semiconductor ASA
#
# SPDX-License-Identifier: Apache-2.0

if BOARD_NRF52_LED_LIGHT

config BOARD
	default "nrf52_led_light"

if ADC

config ADC_0
	default y

endif # ADC

if I2C

config I2C_0
	default y

endif # I2C

if SPI

config SPI_1
	default y

endif # SPI

endif # BOARD_NRF52_LED_LIGHT
```

## boards/arm/nrf52_light_switch/Kconfig
```kconfig
# Kconfig - nRF52 SWITCH LIGHT board configuration
#
# Copyright (c) 2016 Nordic Semiconductor ASA
#
# SPDX-License-Identifier: Apache-2.0

if BOARD_NRF52_LIGHT_SWITCH

config BOARD_ENABLE_DCDC
	bool "Enable DCDC mode"
	select SOC_DCDC_NRF52X
	default y

endif # BOARD_NRF52_LIGHT_SWITCH
```

## boards/arm/nrf52_light_switch/Kconfig.board
```kconfig
# Kconfig - nRF52 Light Switch board configuration
#
# Copyright (c) 2016 Nordic Semiconductor ASA
#
# SPDX-License-Identifier: Apache-2.0

config  BOARD_NRF52_LIGHT_SWITCH
	bool "nRF52-LIGHT_SWITCH"
	depends on SOC_NRF52832_QFAA
```

## boards/arm/nrf52_light_switch/Kconfig.defconfig
```kconfig
# Kconfig - nRF52 Light Switch board configuration
#
# Copyright (c) 2016 Nordic Semiconductor ASA
#
# SPDX-License-Identifier: Apache-2.0

if BOARD_NRF52_LIGHT_SWITCH

config BOARD
	default "nrf52_light_switch"

if ADC

config ADC_0
	default y

endif # ADC

if I2C

config I2C_0
	default y

endif # I2C

if SPI

config SPI_1
	default y

endif # SPI

endif # BOARD_NRF52_LIGHT_SWITCH
```
