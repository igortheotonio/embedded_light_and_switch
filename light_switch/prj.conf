## CMakeLists.txt
```
cmake_minimum_required(VERSION 3.8.2)

set(BOARD_ROOT ${CMAKE_SOURCE_DIR}/../)
set(BOARD light_switch_p1)
include($ENV{ZEPHYR_BASE}/cmake/app/boilerplate.cmake NO_POLICY_SCOPE)
project(LIGHT_SWITCH)

# Generate version file
include(build.version.cmake NO_POLICY_SCOPE)

# Schedule a new version file generation after every build
add_custom_command(
    TARGET app
    POST_BUILD
    COMMAND "${CMAKE_COMMAND}"
    -DPROJECT_SOURCE_DIR=${PROJECT_SOURCE_DIR}
    -DPROJECT_BINARY_DIR=${PROJECT_BINARY_DIR}
    -P ${PROJECT_SOURCE_DIR}/build.version.cmake
    )

list(APPEND HEADERS
    "${PROJECT_BINARY_DIR}/include/generated"
    "${PROJECT_BINARY_DIR}/zephyr/include/generated"
    "${PROJECT_SOURCE_DIR}/include"
    )

list(APPEND SOURCES
    "${PROJECT_SOURCE_DIR}/src/main.c"
    "${PROJECT_SOURCE_DIR}/src/encoder.c"
    "${PROJECT_SOURCE_DIR}/src/leds.c"
    "${PROJECT_SOURCE_DIR}/src/bt_mesh.c"
    "${PROJECT_SOURCE_DIR}/src/bt_callbacks.c"
    "${PROJECT_SOURCE_DIR}/src/node_composition.c"
    "${PROJECT_SOURCE_DIR}/src/firmware_version.c"
    )

include_directories(${HEADERS})
target_sources(app PRIVATE ${SOURCES})
```

## prj.conf
```kconfig
CONFIG_GPIO=y
CONFIG_SERIAL=y
CONFIG_STDOUT_CONSOLE=y
CONFIG_PRINTK=y
CONFIG_PWM=y
CONFIG_LOG=y

#CONFIG_INIT_STACKS=y      # if set, lots of noise from mesh/adv.c: STACK_ANALYZE
CONFIG_MAIN_STACK_SIZE=512
CONFIG_SYSTEM_WORKQUEUE_STACK_SIZE=2048

CONFIG_BT_SETTINGS=y
CONFIG_FLASH=y
CONFIG_FLASH_PAGE_LAYOUT=y
CONFIG_FLASH_MAP=y
CONFIG_FCB=y
CONFIG_SETTINGS=y
CONFIG_SETTINGS_FCB=y
CONFIG_BT_MESH_RPL_STORE_TIMEOUT=600

CONFIG_BOOT_BANNER=y

CONFIG_BT_OBSERVER=y
CONFIG_BT_BROADCASTER=y
CONFIG_BT_CTLR_DUP_FILTER_LEN=0
CONFIG_BT_CTLR_LE_ENC=n
CONFIG_BT_CTLR_LE_PING=n
CONFIG_BT_DATA_LEN_UPDATE=n
CONFIG_BT_PHY_UPDATE=n
CONFIG_BT_CTLR_CHAN_SEL_2=n
CONFIG_BT_CTLR_MIN_USED_CHAN=n
CONFIG_BT_CTLR_ADV_EXT=n
CONFIG_BT_CTLR_PRIVACY=n

CONFIG_BT_PERIPHERAL=y

CONFIG_BT=y
CONFIG_BT_TINYCRYPT_ECC=y
CONFIG_BT_RX_BUF_COUNT=30
CONFIG_BT_L2CAP_RX_MTU=69
CONFIG_BT_L2CAP_TX_MTU=69
CONFIG_BT_L2CAP_TX_BUF_COUNT=8

CONFIG_BT_MESH=y
CONFIG_BT_MESH_RELAY=y
CONFIG_BT_MESH_LOW_POWER=n
CONFIG_BT_MESH_FRIEND=n
CONFIG_BT_MESH_FRIEND_QUEUE_SIZE=16
CONFIG_BT_MESH_ADV_BUF_COUNT=60
CONFIG_BT_MESH_TX_SEG_MAX=12

CONFIG_BT_MESH_PB_GATT=y
CONFIG_BT_MESH_PB_ADV=y
CONFIG_BT_MESH_GATT_PROXY=y
CONFIG_BT_MESH_CFG_CLI=y

CONFIG_BT_MESH_SUBNET_COUNT=2
CONFIG_BT_MESH_APP_KEY_COUNT=2
CONFIG_BT_MESH_MODEL_KEY_COUNT=2
CONFIG_BT_MESH_MODEL_GROUP_COUNT=2
CONFIG_BT_MESH_LABEL_COUNT=3

CONFIG_UART_CONSOLE=y

CONFIG_BT_DEBUG_LOG=y

CONFIG_BT_MESH_DEBUG=y

CONFIG_BT_RX_STACK_SIZE=4096

CONFIG_BT_MAX_CONN=10
CONFIG_BT_CTLR_RX_BUFFERS=6
CONFIG_BT_CTLR_TX_BUFFERS=4
CONFIG_BT_HCI_CMD_COUNT=4

CONFIG_BT_ATT_PREPARE_COUNT=2

CONFIG_BT_DEVICE_NAME="LIGHT SWITCH P1"

CONFIG_LOG_BUFFER_SIZE=4096

CONFIG_HAS_SEGGER_RTT=y
CONFIG_USE_SEGGER_RTT=y
CONFIG_RTT_CONSOLE=y

CONFIG_UART_CONSOLE=n
```

## src/main.c
```c
#include <logging/log.h>
#include <misc/printk.h>
#include <misc/util.h>
#include <zephyr.h>

#include "bt_mesh.h"
#include "encoder.h"
#include "firmware_version.h"
#include "leds.h"

LOG_MODULE_REGISTER(MAIN);

encoder_device_t encoder = {0};
leds_device_t leds       = {0};

int setup_peripherals()
{
    int err = 0;

    // Init and configure leds
    err = leds_init_and_configure(&leds);

    if (err) {
        LOG_ERR("LEDS ERROR: %d", err);
        return err;
    }

    // Init and configure bluetooh
    err = bt_init_and_configure();

    if (err) {
        LOG_ERR("BLUETOOTH ERROR: %d", err);
        return err;
    }

    // Init and configure encoder
    err = encoder_init_and_configure(&encoder);

    if (err) {
        LOG_ERR("ENCODER ERROR: %d", err);
        return err;
    }

    return 0;
}

void main(void)
{
    int err = 0;

    // Firmware version
    LOG_WRN("FIRMWARE VERSION: %d.%d.%d\n", version_get_major(), version_get_minor(),
            version_get_build());

    // Inits peripherals
    err = setup_peripherals();

    if (err) {
        LOG_ERR("ERROR IN SETUP");
        return;
    }

    // Loop
    while (1) {
        k_sleep(K_MSEC(SLEEP_TIME));
    }
}
```

## include/bt_callbacks.h
```c
#ifndef _BT_CALLBACKS_H
#define _BT_CALLBACKS_H

#include <bluetooth/bluetooth.h>
#include <bluetooth/mesh.h>
#include <logging/log.h>
#include <misc/printk.h>
#include <settings/settings.h>

#include "defines.h"
#include "leds.h"

void light_lightness_linear_status(struct bt_mesh_model *model, struct bt_mesh_msg_ctx *ctx,
                                   struct net_buf_simple *buf);

void light_lightness_last_status(struct bt_mesh_model *model, struct bt_mesh_msg_ctx *ctx,
                                 struct net_buf_simple *buf);

void light_lightness_default_status(struct bt_mesh_model *model, struct bt_mesh_msg_ctx *ctx,
                                    struct net_buf_simple *buf);

void light_lightness_range_status(struct bt_mesh_model *model, struct bt_mesh_msg_ctx *ctx,
                                  struct net_buf_simple *buf);

void send_light_lightness_get(struct lightness_cli *bt_cli, u32_t message_type);

void send_light_lightness_linear_set(struct lightness_cli *bt_cli);

#endif  // _BT_CALLBACKS_H
```

## include/bt_mesh.h
```c
#ifndef _BT_MESH_H
#define _BT_MESH_H

#include <bluetooth/bluetooth.h>
#include <bluetooth/mesh.h>
#include <misc/printk.h>
#include <settings/settings.h>

#include "bt_callbacks.h"
#include "node_composition.h"

static struct k_timer timer_counter;

int output_number(bt_mesh_output_action_t action, u32_t number);

void prov_complete(u16_t net_idx, u16_t addr);

void prov_reset(void);

void bt_ready(int err);

int bt_init_and_configure();

#endif  // _BT_MESH_H
```

## include/button.h
```c
#ifndef _BUTTONS_H_
#define _BUTTONS_H_

#include <device.h>
#include <gpio.h>
#include <misc/util.h>
#include <zephyr/types.h>

#include "defines.h"

// Buttons device struct
typedef struct {
    struct device *ic_device;
    struct gpio_callback ic_device_cb;
    u8_t initiated;
} ic_buttons_device_t;

int ic_buttons_init_device(ic_buttons_device_t *buttons_device);

void ic_buttons_configure(ic_buttons_device_t *buttons_device);

void ic_buttons_configure_callback(ic_buttons_device_t *buttons_device,
                                   gpio_callback_handler_t callback_function);

#endif  // _IC_BUTTONS_H_
```

## include/defines.h
```c
#ifndef _DEFINES_H
#define _DEFINES_H

/*
    # Defines of inputs
*/

// Inputs
#define BUTTON_CONTROLLER SW0_GPIO_CONTROLLER
#define BUTTON SW0_GPIO_PIN
#define ENCODER_CHANNEL_A SW1_GPIO_PIN
#define ENCODER_CHANNEL_B SW2_GPIO_PIN
#define NUMBER_OF_INPUTS 3

// Flags
#define EDGE (SW0_GPIO_FLAGS | GPIO_INT_EDGE)
#define PULL_NORMAL SW0_GPIO_FLAGS

#define STANDARD_BUTTON GPIO_DIR_IN | GPIO_INT | PULL_NORMAL | EDGE
#

/*
    # Defines of outputs
*/

// Outputs
#define LED_PORT LED0_GPIO_CONTROLLER
#define LED0 LED0_GPIO_PIN
#define LED1 LED1_GPIO_PIN
#define LED2 LED2_GPIO_PIN
#define LED3 LED3_GPIO_PIN
#define LED4 LED4_GPIO_PIN

// Flags
#define MAX_PWM_PERIOD (USEC_PER_SEC / 50)
#define MIN_PWM_PERIOD 0

/*
    # Defines of leds
*/

#define STANDARD_LED GPIO_DIR_OUT | GPIO_PUD_PULL_UP | GPIO_INT_ACTIVE_HIGH
#define NUMBER_OF_BLINKS 5
#define MAX_BRIGHTNESS 65535
#define MIN_BRIGHTNESS 0
#define NUMBER_OF_LEDS 5
#define LED_BRIGHTNESS_PART (100 / NUMBER_OF_LEDS)
#define LED_ON 0
#define LED_OFF 1
#define ON 1
#define OFF 0

/*
    # Defines of encoder
*/

#define INITIAL_STATE 0
#define INITIAL_POSITION 0
#define SIZE_ONE_STATE 1
#define SIZE_TWO_STATE 2
#define STEP_ENC 3277

/*
    # Defines of timers
*/

#define SLEEP_TIME 500
#define BUTTON_DEBOUNCE_DELAY 250

/*
    # Bluetooth Defines
*/
#define BT_MESH_MODEL_LIGHT_LIGHTNESS_LINEAR_STATUS BT_MESH_MODEL_OP_2(0x82, 0x52)
#define BT_MESH_MODEL_LIGHT_LIGHTNESS_LAST_STATUS BT_MESH_MODEL_OP_2(0x82, 0x54)
#define BT_MESH_MODEL_LIGHT_LIGHTNESS_DEFAULT_STATUS BT_MESH_MODEL_OP_2(0x82, 0x56)
#define BT_MESH_MODEL_LIGHT_LIGHTNESS_RANGE_STATUS BT_MESH_MODEL_OP_2(0x82, 0x58)

#define BT_MESH_MODEL_LIGHT_LIGHTNESS_ACTUAL_GET BT_MESH_MODEL_OP_2(0x82, 0x4B)
#define BT_MESH_MODEL_LIGHT_LIGHTNESS_LAST_GET BT_MESH_MODEL_OP_2(0x82, 0x53)
#define BT_MESH_MODEL_LIGHT_LIGHTNESS_DEFAULT_GET BT_MESH_MODEL_OP_2(0x82, 0x55)
#define BT_MESH_MODEL_LIGHT_LIGHTNESS_RANGE_GET BT_MESH_MODEL_OP_2(0x82, 0x57)
#define BT_MESH_MODEL_LIGHT_LIGHTNESS_LINEAR_GET BT_MESH_MODEL_OP_2(0x82, 0x4F)

#define BT_MESH_MODEL_LIGHT_LIGHTNESS_LINEAR_SET BT_MESH_MODEL_OP_2(0x82, 0x50)

#endif  // _DEFINES_H
```

## include/encoder.h
```c
#ifndef _ENCODER_H_
#define _ENCODER_H_

#include <device.h>
#include <gpio.h>
#include <logging/log.h>
#include <misc/util.h>
#include <zephyr/types.h>

#include "bt_callbacks.h"
#include "defines.h"
#include "functions.h"
#include "leds.h"
#include "node_composition.h"

static const s8_t encoder_diretion[] = {1, -1, -1, 1};

// Encoder device struct
typedef struct {
    struct device *m_device;
    struct gpio_callback m_device_cb;
    u8_t m_initiated;
    u16_t m_state;
    s8_t m_position;
} encoder_device_t;

extern encoder_device_t encoder;

int encoder_init(encoder_device_t *encoder_device);

int encoder_configure(encoder_device_t *encoder_device);

int encoder_init_and_configure(encoder_device_t *encoder_device);

void encoder_configure_callback(encoder_device_t *encoder_device);

#endif  // _ENCODER_H_
```

## include/firmware_version.h
```c
#ifndef _FIRMWARE_VERSION_H_
#define _FIRMWARE_VERSION_H_

#include <zephyr/types.h>

#include "current_version.h"

typedef struct {
    u8_t major;
    u8_t minor;
    u16_t build;
} version_t;

const version_t *version_instance();
u8_t version_get_major();
u8_t version_get_minor();
u16_t version_get_build();

#endif
```

## include/functions.h
```c
#ifndef _FUNCTIONS_H
#define _FUNCTIONS_H

#include <zephyr.h>

#include "defines.h"

static s32_t ceiling(float num)
{
    s32_t inum;

    inum = (s32_t) num;
    if (num == (float) inum) {
        return inum;
    }

    return inum + 1;
}

static u16_t actual_to_linear(u16_t actual)
{
    float tmp;

    tmp = ((float) actual / MAX_BRIGHTNESS);

    return (u16_t) ceiling(MAX_BRIGHTNESS * tmp * tmp);
}

static int max(int a, int b)
{
    return (a > b) ? a : b;
}

static int min(int a, int b)
{
    return (a < b) ? a : b;
}

#endif  // _FUNCTIONS_H
```

## include/leds.h
```c
#ifndef _IC_LEDS_H_
#define _IC_LEDS_H_

#include <device.h>
#include <gpio.h>
#include <logging/log.h>
#include <pwm.h>
#include <zephyr/types.h>

#include "defines.h"
#include "node_composition.h"

typedef struct {
    struct device *m_device;
    u16_t m_brightness;
    u8_t m_initiated;
    u8_t m_state;
} leds_device_t;

extern leds_device_t leds;

int leds_init(leds_device_t *leds_device);

int leds_configure(leds_device_t *leds_device);

int turn_all_leds_on(leds_device_t *leds_device);

int turn_all_leds_off(leds_device_t *leds_device);

int leds_brightness(leds_device_t *leds_device);

int leds_init_and_configure(leds_device_t *leds_device);

#endif  // _IC_LEDS_H_
```

## include/node_composition.h
```c
#ifndef _NODE_COMPOSITION_H
#define _NODE_COMPOSITION_H

#include <bluetooth/bluetooth.h>
#include <bluetooth/mesh.h>
#include <logging/log.h>
#include <misc/printk.h>
#include <settings/settings.h>

#include "bt_callbacks.h"

struct lightness_cli {
    struct bt_mesh_model *m_model_cli;
    u8_t received_msg;
    u16_t m_linear;
    u16_t m_last;
    u16_t m_default;
    u16_t m_min_range;
    u16_t m_max_range;
    u8_t m_tid;
};

extern struct lightness_cli light_lightness_cli[];
extern struct bt_mesh_model change_model[];
extern const struct bt_mesh_comp comp;

#endif  // _NODE_COMPOSITION_H
```

## include/state.h
```c
#ifndef _STATE_H
#define _STATE_H

#include <logging/log.h>
#include <misc/printk.h>
#include <zephyr.h>

typedef enum { S0, S1, S2, S3, S4, S5, number_of_states } state_e;
typedef enum {
    timeout,
    zero,
    encoder_right,
    encoder_left,
    button_pressed,
    number_of_events
} event_e;

static char *event_string[] = {"Timeout", "Zero", "Encoder_Right", "Encoder_Left",
                               "Button_Pressed"};

typedef void (*action_function)();
typedef state_e (*next_state_function)(event_e);

typedef struct {
    char *m_name;
    uint8_t m_switch_state;
    uint8_t m_light_state;
    uint16_t m_pulse_width;
    uint16_t m_leds;

    action_function action;
    next_state_function next_state;
} state;

state_e S0_next_state(event_e event);
state_e S1_next_state(event_e event);
state_e S2_next_state(event_e event);
state_e S3_next_state(event_e event);
state_e S4_next_state(event_e event);
state_e S5_next_state(event_e event);

void S0_action();
void S1_action();
void S2_action();
void S3_action();
void S4_action();
void S5_action();

#endif  // _STATE_H
```

## include/state_machine.h
```c
#ifndef _STATE_MACHINE_H
#define _STATE_MACHINE_H

#include <logging/log.h>
#include <misc/printk.h>
#include <zephyr.h>

#include "state.h"

typedef struct {
} state_machine;

int transition_machine(event_e event);

#endif  // _STATE_MACHINE_H
```

## src/bt_callbacks.c
```c
#include "bt_callbacks.h"

LOG_MODULE_REGISTER(BT_CALLBACKS, 4);

void light_lightness_linear_status(struct bt_mesh_model *model, struct bt_mesh_msg_ctx *ctx,
                                   struct net_buf_simple *buf)
{
    u16_t linear                    = net_buf_simple_pull_le16(buf);
    light_lightness_cli[0].m_linear = linear;
    leds.m_brightness               = linear;
    leds_brightness(&leds);
    light_lightness_cli[0].received_msg = 2;
    LOG_INF("PRESENT LIGHTNESS = %04x", linear);
}

void light_lightness_last_status(struct bt_mesh_model *model, struct bt_mesh_msg_ctx *ctx,
                                 struct net_buf_simple *buf)
{
    u16_t actual_last                   = net_buf_simple_pull_le16(buf);
    light_lightness_cli[0].m_last       = actual_last;
    light_lightness_cli[0].received_msg = 2;
    LOG_INF("LAST LIGHTNESS = %04x", actual_last);
}

void light_lightness_default_status(struct bt_mesh_model *model, struct bt_mesh_msg_ctx *ctx,
                                    struct net_buf_simple *buf)
{
    u16_t actual_default                = net_buf_simple_pull_le16(buf);
    light_lightness_cli[0].m_default    = actual_default;
    light_lightness_cli[0].received_msg = 2;
    LOG_INF("DEFAULT LIGHTNESS = %04x", actual_default);
}

void light_lightness_range_status(struct bt_mesh_model *model, struct bt_mesh_msg_ctx *ctx,
                                  struct net_buf_simple *buf)
{
    u8_t status_code                   = net_buf_simple_pull_u8(buf);
    u16_t actual_min_range             = net_buf_simple_pull_le16(buf);
    u16_t actual_max_range             = net_buf_simple_pull_le16(buf);
    light_lightness_cli[0].m_min_range = actual_min_range;
    light_lightness_cli[0].m_max_range = actual_max_range;

    light_lightness_cli[0].received_msg = 2;
    LOG_INF("STATUS CODE = %02x", status_code);
    LOG_INF("RANGE MIN = %04x", actual_min_range);
    LOG_INF("RANGE MAX = %04x", actual_max_range);
}


void send_light_lightness_get(struct lightness_cli *bt_cli, u32_t message_type)
{
    struct bt_mesh_model_pub *pub_cli;
    pub_cli = bt_cli->m_model_cli->pub;

    switch (message_type) {
    case BT_MESH_MODEL_LIGHT_LIGHTNESS_RANGE_GET:
        LOG_INF("SENDING RANGE GET MESSAGE TO 0x%04x", pub_cli->addr);
        break;
    case BT_MESH_MODEL_LIGHT_LIGHTNESS_DEFAULT_GET:
        LOG_INF("SENDING DEFAULT GET MESSAGE TO 0x%04x", pub_cli->addr);
        break;
    case BT_MESH_MODEL_LIGHT_LIGHTNESS_LINEAR_GET:
        LOG_INF("SENDING LINEAR GET MESSAGE TO 0x%04x", pub_cli->addr);
        break;
    case BT_MESH_MODEL_LIGHT_LIGHTNESS_LAST_GET:
        LOG_INF("SENDING LAST GET MESSAGE TO 0x%04x", pub_cli->addr);
        break;
    default:
        return;
    }

    bt_mesh_model_msg_init(pub_cli->msg, message_type);
    int err = bt_mesh_model_publish(bt_cli->m_model_cli);
    if (err) {
        LOG_ERR("BT MESH MODEL PUB ERR %d MESSAGE TO 0x%04x", err, pub_cli->addr);
    }
}

void send_light_lightness_linear_set(struct lightness_cli *bt_cli)
{
    struct bt_mesh_model_pub *pub_cli;
    pub_cli = bt_cli->m_model_cli->pub;
    LOG_INF("SENDING SET LINEAR MESSAGE 0x%04x TO 0x%04x", leds.m_brightness, pub_cli->addr);

    bt_mesh_model_msg_init(pub_cli->msg, BT_MESH_MODEL_LIGHT_LIGHTNESS_LINEAR_SET);
    net_buf_simple_add_le16(pub_cli->msg, leds.m_brightness);
    net_buf_simple_add_u8(pub_cli->msg, bt_cli->m_tid++);

    int err = bt_mesh_model_publish(bt_cli->m_model_cli);
    if (err) {
        LOG_ERR("BT MESH MODEL PUB ERR %d MESSAGE TO 0x%04x", err, pub_cli->addr);
    }
}
```
