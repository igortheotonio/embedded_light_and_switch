## CMakeLists.txt
```
cmake_minimum_required(VERSION 3.8.2)

set(BOARD_ROOT ${CMAKE_SOURCE_DIR}/../)
include($ENV{ZEPHYR_BASE}/cmake/app/boilerplate.cmake NO_POLICY_SCOPE)
project(BRING_UP_LED_LIGHT)

# Generate version file
include(build.version.cmake NO_POLICY_SCOPE)

# Schedule a new version file generation after every build
add_custom_command(
    TARGET app
    POST_BUILD
    COMMAND "${CMAKE_COMMAND}"
    -DPROJECT_SOURCE_DIR=${PROJECT_SOURCE_DIR}
    -DPROJECT_BINARY_DIR=${PROJECT_BINARY_DIR}
    -P ${PROJECT_SOURCE_DIR}/build.version.cmake
    )

list(APPEND HEADERS
    "${PROJECT_BINARY_DIR}/include/generated"
    "${PROJECT_BINARY_DIR}/zephyr/include/generated"
    "${PROJECT_SOURCE_DIR}/include"
    )

list(APPEND SOURCES
    "${PROJECT_SOURCE_DIR}/src/main.c"
    "${PROJECT_SOURCE_DIR}/src/firmware_version.c"
    "${PROJECT_SOURCE_DIR}/src/bt_callbacks.c"
    "${PROJECT_SOURCE_DIR}/src/bt_mesh.c"
    "${PROJECT_SOURCE_DIR}/src/node_composition.c"
    "${PROJECT_SOURCE_DIR}/src/pwm_driver.c"
    )

include_directories(${HEADERS})
target_sources(app PRIVATE ${SOURCES})
```

## prj.conf
```kconfig
CONFIG_INIT_STACKS=n
CONFIG_MAIN_STACK_SIZE=512
CONFIG_SYSTEM_WORKQUEUE_STACK_SIZE=4096

CONFIG_BT_SETTINGS=y
CONFIG_FLASH=y
CONFIG_FLASH_PAGE_LAYOUT=y
CONFIG_FLASH_MAP=y
CONFIG_FCB=y
CONFIG_SETTINGS=y
CONFIG_SETTINGS_FCB=y

CONFIG_BT_OBSERVER=y
CONFIG_BT_BROADCASTER=y
CONFIG_BT_CTLR_DUP_FILTER_LEN=0
CONFIG_BT_CTLR_LE_ENC=n
CONFIG_BT_CTLR_LE_PING=n
CONFIG_BT_DATA_LEN_UPDATE=n
CONFIG_BT_PHY_UPDATE=n
CONFIG_BT_CTLR_CHAN_SEL_2=n
CONFIG_BT_CTLR_MIN_USED_CHAN=n
CONFIG_BT_CTLR_ADV_EXT=n
CONFIG_BT_CTLR_PRIVACY=n
CONFIG_BT_CTLR_TX_PWR_PLUS_8=y

CONFIG_BT_PERIPHERAL=y
CONFIG_BT=y
CONFIG_BT_TINYCRYPT_ECC=y
CONFIG_BT_RX_BUF_COUNT=30
CONFIG_BT_RX_STACK_SIZE=4096
CONFIG_BT_L2CAP_RX_MTU=69
CONFIG_BT_L2CAP_TX_MTU=69
CONFIG_BT_L2CAP_TX_BUF_COUNT=8

CONFIG_BT_MESH=y
CONFIG_BT_MESH_RELAY=y
CONFIG_BT_MESH_LOW_POWER=n
CONFIG_BT_MESH_FRIEND=n
CONFIG_BT_MESH_FRIEND_QUEUE_SIZE=16
CONFIG_BT_MESH_ADV_BUF_COUNT=60
CONFIG_BT_MESH_TX_SEG_MAX=6
CONFIG_BT_MESH_TX_SEG_MSG_COUNT=3
CONFIG_BT_MESH_RX_SEG_MSG_COUNT=3
CONFIG_BT_MESH_CRPL=128
CONFIG_BT_MESH_RPL_STORE_TIMEOUT=120
CONFIG_BT_MESH_MSG_CACHE_SIZE=100

CONFIG_BT_MESH_PB_GATT=y
CONFIG_BT_MESH_PB_ADV=y
CONFIG_BT_MESH_GATT_PROXY=y

#CONFIG_BT_MESH_LPN_SCAN_LATENCY=30
#CONFIG_BT_MESH_LPN_RECV_DELAY=40
#CONFIG_BT_MESH_LPN_POLL_TIMEOUT=300

CONFIG_BT_MESH_SUBNET_COUNT=2
CONFIG_BT_MESH_APP_KEY_COUNT=2
CONFIG_BT_MESH_MODEL_GROUP_COUNT=2
CONFIG_BT_MESH_LABEL_COUNT=2

#CONFIG_BT_MESH_IV_UPDATE_TEST=y

#CONFIG_UART_CONSOLE=n
#CONFIG_BT_DEBUG_MONITOR=y
#CONFIG_BT_DEBUG_LOG=y

##CONFIG_BT_MESH_DEBUG=y
#CONFIG_BT_MESH_DEBUG_PROV=y
#CONFIG_BT_MESH_DEBUG_PROXY=y
#CONFIG_BT_MESH_DEBUG_BEACON=y
#CONFIG_BT_MESH_DEBUG_NET=y
#CONFIG_BT_MESH_DEBUG_TRANS=y
#CONFIG_BT_MESH_DEBUG_SETTINGS=y
#CONFIG_BT_MESH_DEBUG_LOW_POWER=y
#CONFIG_BT_MESH_DEBUG_FRIEND=y
#CONFIG_BT_MESH_DEBUG_MODEL=y
#CONFIG_BT_MESH_DEBUG_ACCESS=y
#CONFIG_BT_MESH_DEBUG_CRYPTO=y
#CONFIG_BT_MESH_DEBUG_ADV=y
#CONFIG_BT_MESH_SELF_TEST=y

CONFIG_GPIO=y
CONFIG_LOG=y
CONFIG_PWM=y
```

## src/main.c
```c
/**
 * @file main.c
 * @author your name (you@domain.com)
 * @brief
 * @version 0.1
 * @date 2018-12-25
 *
 * @copyright Copyright (c) 2018
 *
 */

#include <logging/log.h>
#include <zephyr/types.h>

#include "bt_mesh.h"
#include "firmware_version.h"
#include "global_state.h"
#include "pwm_driver.h"

#define SLEEP_TIME 250

pwm_driver_t pwm_driver = {0};
u8_t state              = 0;

LOG_MODULE_REGISTER(MAIN, 4);

// Initializing BLE

int configure_board()
{
    if (init_pwm_driver(&pwm_driver, PWM_DRIVER, PWM_CHANNEL0, PERIOD)) {
        return -EINVAL;
    }
    return 0;
}

void main(void)
{
    LOG_WRN("Firmware version: %d.%d.%d\n", version_get_major(), version_get_minor(),
            version_get_build());

    int err = configure_board();

    if (err) {
        LOG_ERR("The board configuration failed with err %d", err);
        return;
    }

    err = bt_enable(bt_ready);
    if (err) {
        LOG_ERR("bt_enable failed with err %d\n", err);
        return;
    }
    while (1) {
        if (!state) {
            change_pulse_width(&pwm_driver, PERIOD / 2);
            set_pulse_width(&pwm_driver);
        } else {
            change_pulse_width(&pwm_driver, 0);
            set_pulse_width(&pwm_driver);
        }
        k_sleep(SLEEP_TIME);
    }
}
```

## include/bt_callbacks.h
```c
/**
 * @file ic_bt.h
 * @Lucas Peixoto (lpdac@ic.ufal.br)
 * @brief
 * @version 0.1
 * @date 2018-12-25
 *
 * @copyright Copyright (c) 2018
 *
 */

#ifndef _IC_BT_H
#define _IC_BT_H

#include <bluetooth/bluetooth.h>
#include <bluetooth/conn.h>
#include <bluetooth/hci.h>
#include <bluetooth/l2cap.h>
#include <bluetooth/mesh.h>
#include <settings/settings.h>

extern const struct bt_mesh_model_op generic_onoff_srv_op[];


// Generic OnOff Messages Types
#define BT_MESH_MODEL_OP_GENERIC_ONOFF_GET BT_MESH_MODEL_OP_2(0x82, 0x01)
#define BT_MESH_MODEL_OP_GENERIC_ONOFF_SET BT_MESH_MODEL_OP_2(0x82, 0x02)
#define BT_MESH_MODEL_OP_GENERIC_ONOFF_SET_UNACK BT_MESH_MODEL_OP_2(0x82, 0x03)
#define BT_MESH_MODEL_OP_GENERIC_ONOFF_STATUS BT_MESH_MODEL_OP_2(0x82, 0x04)


/**
 * @brief
 *
 * @param model
 * @param ctx
 * @param buf
 */
void generic_onoff_get(struct bt_mesh_model *model, struct bt_mesh_msg_ctx *ctx,
                       struct net_buf_simple *buf);


/**
 * @brief
 *
 * @param model
 * @param ctx
 * @param buf
 */
void generic_onoff_set(struct bt_mesh_model *model, struct bt_mesh_msg_ctx *ctx,
                       struct net_buf_simple *buf);


/**
 * @brief
 *
 * @param model
 * @param ctx
 * @param buf
 */
void generic_onoff_set_unack(struct bt_mesh_model *model, struct bt_mesh_msg_ctx *ctx,
                             struct net_buf_simple *buf);

void generic_onoff_status(struct bt_mesh_model *model, struct bt_mesh_msg_ctx *ctx,
                          struct net_buf_simple *buf);
#endif
```

## include/bt_mesh.h
```c
#ifndef _BT_MESH_H_
#define _BT_MESH_H_

#include <bluetooth/bluetooth.h>
#include <bluetooth/conn.h>
#include <bluetooth/hci.h>
#include <bluetooth/l2cap.h>
#include <bluetooth/mesh.h>
#include <settings/settings.h>

#include "node_composition.h"


void bt_ready(int err);

#endif
```

## include/firmware_version.h
```c
#ifndef _VERSION_H_
#define _VERSION_H_

#include <zephyr/types.h>

typedef struct {
    u8_t major;
    u8_t minor;
    u16_t build;
} version_t;

const version_t *version_instance();
u8_t version_get_major();
u8_t version_get_minor();
u16_t version_get_build();

#endif  // _VERSION_H_
```

## include/global_state.h
```c
#ifndef _GLOBAL_STATE_H_
#define _GLOBAL_STATE_H_

#include <zephyr/types.h>

extern u8_t state;

#endif
```

## include/node_composition.h
```c
#ifndef _NODE_COMPOSITION_H_
#define _NODE_COMPOSITION_H_

#include "bt_callbacks.h"

extern const struct bt_mesh_comp comp;

#endif
```

## src/bt_callbacks.c
```c
/**
 * @file ic_bt.c
 * @Lucas Peixoto (lpdac@ic.ufal.br)
 * @brief
 * @version 0.1
 * @date 2018-12-25
 *
 * @copyright Copyright (c) 2018
 *
 */

#include "bt_callbacks.h"

#include <logging/log.h>

LOG_MODULE_REGISTER(BT_CALLBACKS, 4);

const struct bt_mesh_model_op generic_onoff_srv_op[] = {
    {BT_MESH_MODEL_OP_GENERIC_ONOFF_GET, 0, generic_onoff_get},
    {BT_MESH_MODEL_OP_GENERIC_ONOFF_SET, 2, generic_onoff_set},
    {BT_MESH_MODEL_OP_GENERIC_ONOFF_SET_UNACK, 2, generic_onoff_set_unack},
    BT_MESH_MODEL_OP_END,
};

void generic_onoff_get(struct bt_mesh_model *model, struct bt_mesh_msg_ctx *ctx,
                       struct net_buf_simple *buf)
{
    LOG_DBG("[0x%04x]: Received a get msg from group address 0x%04x, sended by 0x%04x.\n",
            bt_mesh_model_elem(model)->addr, ctx->recv_dst, ctx->addr);

    struct net_buf_simple *msg = NET_BUF_SIMPLE(2 + 2 + 4);
    u8_t *state                = model->user_data;

    // 2 bytes for the opcode
    // 1 bytes parameters: present onoff value
    // 2 optional bytes for target onoff and remaining time
    // 4 additional bytes for the TransMIC


    LOG_DBG("Sending onoff status msg, value -> %d\n", *state);

    // Building msg

    bt_mesh_model_msg_init(msg, BT_MESH_MODEL_OP_GENERIC_ONOFF_STATUS);
    net_buf_simple_add_u8(msg, *state);

    if (bt_mesh_model_send(model, ctx, msg, NULL, NULL)) {
        LOG_ERR("Unable to send onoff status response\n");
    }
}


void generic_onoff_set(struct bt_mesh_model *model, struct bt_mesh_msg_ctx *ctx,
                       struct net_buf_simple *buf)
{
    generic_onoff_set_unack(model, ctx, buf);
    generic_onoff_get(model, ctx, buf);
}


void generic_onoff_set_unack(struct bt_mesh_model *model, struct bt_mesh_msg_ctx *ctx,
                             struct net_buf_simple *buf)
{
    LOG_DBG("[0x%04x]: Received a set msg from group address 0x%04x, sended by 0x%04x.\n",
            bt_mesh_model_elem(model)->addr, ctx->recv_dst, ctx->addr);

    u8_t *state          = model->user_data;
    u8_t buflen          = buf->len;
    u8_t new_onoff_state = net_buf_simple_pull_u8(buf);
    u8_t tid             = net_buf_simple_pull_u8(buf);

    if (buflen > 2) {
        LOG_WRN("[wrn]: message contains transition_time field - processing not implemented\n");
    }

    if (buflen > 3) {
        LOG_WRN("[wrn]: message contains delay field - processing not implemented\n");
    }

    LOG_DBG("[0x%04x]: Value msg -> %d/ TID -> %d\n", bt_mesh_model_elem(model)->addr,
            new_onoff_state, tid);
    *state = new_onoff_state;
}
```

## src/bt_mesh.c
```c
#include "bt_mesh.h"

#include <logging/log.h>

LOG_MODULE_REGISTER(BT_MESH, 4);

// Bluetooth mesh initialization

static uint8_t dev_uuid[16] = {0xdd, 0xdd};

static int output_number(bt_mesh_output_action_t action, u32_t number)
{
    LOG_WRN("OOB Number: %u\n", number);
    return 0;
}

static int output_string(const char *str)
{
    LOG_WRN("%s string\n", str);
    return 0;
}


static void prov_complete(u16_t net_idx, u16_t addr)
{
    LOG_WRN("Provisioning was completed.\n");
}

static void prov_reset(void)
{
    bt_mesh_prov_enable(BT_MESH_PROV_ADV | BT_MESH_PROV_GATT);
}

static const struct bt_mesh_prov prov = {
    .uuid           = dev_uuid,
    .output_size    = 1,
    .output_actions = BT_MESH_DISPLAY_NUMBER | BT_MESH_DISPLAY_STRING,
    .output_number  = output_number,
    .output_string  = output_string,
    .complete       = prov_complete,
    .reset          = prov_reset,
};

void bt_ready(int err)
{
    struct bt_le_oob oob;

    if (err) {
        LOG_ERR("Bluetooth init failed (err %d)\n", err);
        return;
    }

    LOG_WRN("Bluetooth initialized\n");

    err = bt_mesh_init(&prov, &comp);
    if (err) {
        LOG_ERR("Initializing mesh failed (err %d)\n", err);
        return;
    }

    if (IS_ENABLED(CONFIG_SETTINGS)) {
        settings_load();
    }

    /* Use identity address as device UUID */
    if (bt_le_oob_get_local(BT_ID_DEFAULT, &oob)) {
        LOG_ERR("Identity Address unavailable\n");
    } else {
        memcpy(dev_uuid, oob.addr.a.val, 6);
    }

    bt_mesh_prov_enable(BT_MESH_PROV_GATT | BT_MESH_PROV_ADV);

    LOG_WRN("Mesh initialized\n");
}
```

## src/firmware_version.c
```c
#include "firmware_version.h"

#include "current_version.h"

static const version_t __version = {VERSION_MAJOR, VERSION_MINOR, VERSION_BUILD};

const version_t *version_instance()
{
    return &__version;
}

u8_t version_get_major()
{
    return __version.major;
}

u8_t version_get_minor()
{
    return __version.minor;
}
u16_t version_get_build()
{
    return __version.build;
}
```

## src/node_composition.c
```c
#include "node_composition.h"

#include "global_state.h"

BT_MESH_MODEL_PUB_DEFINE(pub_onoff_srv, NULL, 2 + 2 + 1);
BT_MESH_HEALTH_PUB_DEFINE(health_pub, 0);

static struct bt_mesh_health_srv health_srv = {};

static struct bt_mesh_cfg_srv cfg_srv = {
    .relay            = BT_MESH_RELAY_DISABLED,
    .beacon           = BT_MESH_BEACON_ENABLED,
    .frnd             = BT_MESH_FRIEND_NOT_SUPPORTED,
    .gatt_proxy       = BT_MESH_GATT_PROXY_ENABLED,
    .default_ttl      = 7,
    .net_transmit     = BT_MESH_TRANSMIT(2, 20),
    .relay_retransmit = BT_MESH_TRANSMIT(2, 20),
};

static struct bt_mesh_model root_models[] = {
    BT_MESH_MODEL_CFG_SRV(&cfg_srv),
    BT_MESH_MODEL_HEALTH_SRV(&health_srv, &health_pub),
};

static struct bt_mesh_model srv_models[] = {
    BT_MESH_MODEL(BT_MESH_MODEL_ID_GEN_ONOFF_SRV, generic_onoff_srv_op, &pub_onoff_srv, &state),
};

static struct bt_mesh_elem elements[] = {
    BT_MESH_ELEM(0, root_models, BT_MESH_MODEL_NONE),
    BT_MESH_ELEM(0, srv_models, BT_MESH_MODEL_NONE),
};

const struct bt_mesh_comp comp = {
    .cid        = BT_COMP_ID_LF,
    .elem       = elements,
    .elem_count = ARRAY_SIZE(elements),
};
```

## src/pwm_driver.c
```c
#include "pwm_driver.h"

#include <logging/log.h>

LOG_MODULE_REGISTER(PWM_LED, 2);

int init_pwm_driver(pwm_driver_t *pwm_driver, const char *pwm_label, u8_t pin, u16_t period)
{
    if (pwm_driver->initiated) {
        LOG_ERR("pwm_driver is not null");
        return -EBUSY;
    }

    struct device *dev = device_get_binding(pwm_label);
    if (dev == NULL) {
        LOG_ERR("Error getting the device.");
        return -EBUSY;
    }

    pwm_driver->dev         = dev;
    pwm_driver->pin         = pin;
    pwm_driver->period      = period;
    pwm_driver->initiated   = 1;
    pwm_driver->pulse_width = 0;
    LOG_WRN("Pwm driver initiated with pin %d", pin);
    return 0;
}


int change_pulse_width(pwm_driver_t *pwm_driver, u16_t pulse_width)
{
    if (pwm_driver->initiated == 0) {
        LOG_ERR("pwm driver was not initiated.");
        return -ENODEV;
    }

    if (pulse_width > pwm_driver->period || pulse_width < 0) {
        LOG_ERR("The pulse width is going over the edge with %d/%d.", pulse_width,
                pwm_driver->period);
        return -EINVAL;
    }

    LOG_DBG("Change pulseWidth to: %d", pulse_width);

    pwm_driver->pulse_width = pulse_width;
    return 0;
}

int set_pulse_width(pwm_driver_t *pwm_driver)
{
    if (pwm_driver->initiated == 0) {
        LOG_ERR("pwm driver was not initiated.");
        return -ENODEV;
    }
    LOG_DBG("<Pin %d> - Setting pulseWidth to: %d", pwm_driver->pin, pwm_driver->pulse_width);
    int err = pwm_pin_set_usec(pwm_driver->dev, pwm_driver->pin, pwm_driver->period,
                               pwm_driver->pulse_width);
    if (err) {
        LOG_ERR("PWM set failed.\n");
        return err;
    }
    return 0;
}
```
