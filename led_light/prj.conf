## CMakeLists.txt
```
cmake_minimum_required(VERSION 3.8.2)

set(BOARD_ROOT ${CMAKE_SOURCE_DIR}/../)
set(BOARD led_light_p1)
include($ENV{ZEPHYR_BASE}/cmake/app/boilerplate.cmake NO_POLICY_SCOPE)
project(LED_LIGHT)

# Generate version file
include(build.version.cmake NO_POLICY_SCOPE)

# Schedule a new version file generation after every build
add_custom_command(
    TARGET app
    POST_BUILD
    COMMAND "${CMAKE_COMMAND}"
    -DPROJECT_SOURCE_DIR=${PROJECT_SOURCE_DIR}
    -DPROJECT_BINARY_DIR=${PROJECT_BINARY_DIR}
    -P ${PROJECT_SOURCE_DIR}/build.version.cmake
    )

list(APPEND HEADERS
    "${PROJECT_BINARY_DIR}/include/generated"
    "${PROJECT_BINARY_DIR}/zephyr/include/generated"
    "${PROJECT_SOURCE_DIR}/include"
    )

list(APPEND SOURCES
    "${PROJECT_SOURCE_DIR}/src/main.c"
    "${PROJECT_SOURCE_DIR}/src/bt_callbacks.c"
    "${PROJECT_SOURCE_DIR}/src/bt_mesh.c"
    "${PROJECT_SOURCE_DIR}/src/light_lightness_state.c"
    "${PROJECT_SOURCE_DIR}/src/node_composition.c"
    "${PROJECT_SOURCE_DIR}/src/firmware_version.c"
    "${PROJECT_SOURCE_DIR}/src/pwm_driver.c"
    )

include_directories(${HEADERS})
target_sources(app PRIVATE ${SOURCES})
```

## prj.conf
```kconfig
CONFIG_SERIAL=y
CONFIG_STDOUT_CONSOLE=y
CONFIG_PWM=y
CONFIG_LOG=y

CONFIG_INIT_STACKS=n
CONFIG_MAIN_STACK_SIZE=512
CONFIG_SYSTEM_WORKQUEUE_STACK_SIZE=4096

CONFIG_BT_SETTINGS=y
CONFIG_FLASH=y
CONFIG_FLASH_PAGE_LAYOUT=y
CONFIG_FLASH_MAP=y
CONFIG_FCB=y
CONFIG_SETTINGS=y
CONFIG_SETTINGS_FCB=y

CONFIG_BT_OBSERVER=y
CONFIG_BT_BROADCASTER=y
CONFIG_BT_CTLR_DUP_FILTER_LEN=0
CONFIG_BT_CTLR_LE_ENC=n
CONFIG_BT_CTLR_LE_PING=n
CONFIG_BT_DATA_LEN_UPDATE=n
CONFIG_BT_PHY_UPDATE=n
CONFIG_BT_CTLR_CHAN_SEL_2=n
CONFIG_BT_CTLR_MIN_USED_CHAN=n
CONFIG_BT_CTLR_ADV_EXT=n
CONFIG_BT_CTLR_PRIVACY=n
CONFIG_BT_CTLR_TX_PWR_PLUS_8=y

CONFIG_BT_PERIPHERAL=y
CONFIG_BT=y
CONFIG_BT_TINYCRYPT_ECC=y
CONFIG_BT_RX_BUF_COUNT=30
CONFIG_BT_RX_STACK_SIZE=4096
CONFIG_BT_L2CAP_RX_MTU=69
CONFIG_BT_L2CAP_TX_MTU=69
CONFIG_BT_L2CAP_TX_BUF_COUNT=8

CONFIG_BT_MESH=y
CONFIG_BT_MESH_RELAY=y
CONFIG_BT_MESH_LOW_POWER=n
CONFIG_BT_MESH_FRIEND=n
CONFIG_BT_MESH_ADV_BUF_COUNT=60
CONFIG_BT_MESH_TX_SEG_MAX=6
CONFIG_BT_MESH_TX_SEG_MSG_COUNT=3
CONFIG_BT_MESH_RX_SEG_MSG_COUNT=3
CONFIG_BT_MESH_CRPL=128
CONFIG_BT_MESH_RPL_STORE_TIMEOUT=120
CONFIG_BT_MESH_MSG_CACHE_SIZE=100

CONFIG_BT_MESH_PB_GATT=y
CONFIG_BT_MESH_PB_ADV=y
CONFIG_BT_MESH_GATT_PROXY=y

#CONFIG_BT_MESH_LPN_SCAN_LATENCY=30
#CONFIG_BT_MESH_LPN_RECV_DELAY=40
#CONFIG_BT_MESH_LPN_POLL_TIMEOUT=300

CONFIG_BT_MESH_SUBNET_COUNT=2
CONFIG_BT_MESH_APP_KEY_COUNT=2
CONFIG_BT_MESH_MODEL_GROUP_COUNT=2
CONFIG_BT_MESH_LABEL_COUNT=3

CONFIG_BT_MESH_CFG_CLI=y

CONFIG_BT_MAX_CONN=5

#CONFIG_BT_MESH_IV_UPDATE_TEST=y

#CONFIG_UART_CONSOLE=n
#CONFIG_BT_DEBUG_MONITOR=y
#CONFIG_BT_DEBUG_LOG=y

##CONFIG_BT_MESH_DEBUG=y
#CONFIG_BT_MESH_DEBUG_PROV=y
#CONFIG_BT_MESH_DEBUG_PROXY=y
#CONFIG_BT_MESH_DEBUG_BEACON=y
#CONFIG_BT_MESH_DEBUG_NET=y
#CONFIG_BT_MESH_DEBUG_TRANS=y
#CONFIG_BT_MESH_DEBUG_SETTINGS=y
#CONFIG_BT_MESH_DEBUG_LOW_POWER=y
#CONFIG_BT_MESH_DEBUG_FRIEND=y
#CONFIG_BT_MESH_DEBUG_MODEL=y
#CONFIG_BT_MESH_DEBUG_ACCESS=y
#CONFIG_BT_MESH_DEBUG_CRYPTO=y
#CONFIG_BT_MESH_DEBUG_ADV=y
#CONFIG_BT_MESH_SELF_TEST=y

CONFIG_BT_DEVICE_NAME="LED LIGHT P1"
```

## src/main.c
```c
/**
 * @file main.c
 * @brief
 * @author Lucas Peixoto (lucaspeixotoac@gmail.com)
 * @version 0.1
 * @date 2019-03-06
 */


#include <logging/log.h>
#include <zephyr.h>
#include <zephyr/types.h>

#include "bt_mesh.h"
#include "firmware_version.h"
#include "light_lightness_state.h"
#include "pwm_driver.h"

#define SLEEP_TIME 250

LOG_MODULE_REGISTER(MAIN, 4);

pwm_driver_t pwm = {0};


int configure_board()
{
    int err = init_pwm_driver(&pwm, PWM_DRIVER, PWM_CHANNEL0, PERIOD);
    if (err) {
        return err;
    }
    err = change_pulse_width(&pwm, 0x0000);
    if (err) {
        return err;
    }
    return 0;
}


void main(void)
{
    LOG_INF("Firmware version: %d.%d.%d\n", version_get_major(), version_get_minor(),
            version_get_build());

    int err = bt_enable(bt_ready);
    if (err) {
        LOG_ERR("Error on bt enable");
    }

    err = configure_board();
    if (err) {
        LOG_ERR("Error configure board");
    }

    while (1) {
        k_sleep(SLEEP_TIME);
    }
}
```

## include/bt_callbacks.h
```c
#ifndef _BT_CALLBACKS_H_
#define _BT_CALLBACKS_H_

#include <bluetooth/bluetooth.h>
#include <bluetooth/mesh.h>
#include <settings/settings.h>


// LINEAR MESSAGES
#define BT_MESH_MODEL_LIGHT_LIGHTNESS_LINEAR_STATUS BT_MESH_MODEL_OP_2(0x82, 0x52)
#define BT_MESH_MODEL_LIGHT_LIGHTNESS_LINEAR_GET BT_MESH_MODEL_OP_2(0x82, 0x4F)
#define BT_MESH_MODEL_LIGHT_LIGHTNESS_LINEAR_SET BT_MESH_MODEL_OP_2(0x82, 0x50)
#define BT_MESH_MODEL_LIGHT_LIGHTNESS_LINEAR_SET_UNACK BT_MESH_MODEL_OP_2(0x82, 0x51)

// ACTUAL MESSAGES
#define BT_MESH_MODEL_LIGHT_LIGHTNESS_ACTUAL_GET BT_MESH_MODEL_OP_2(0x82, 0x4B)
#define BT_MESH_MODEL_LIGHT_LIGHTNESS_ACTUAL_SET BT_MESH_MODEL_OP_2(0x82, 0x4C)
#define BT_MESH_MODEL_LIGHT_LIGHTNESS_ACTUAL_SET_UNACK BT_MESH_MODEL_OP_2(0x82, 0x4D)
#define BT_MESH_MODEL_LIGHT_LIGHTNESS_ACTUAL_STATUS BT_MESH_MODEL_OP_2(0x82, 0x4E)

// RANGE MESSAGES
#define BT_MESH_MODEL_LIGHT_LIGHTNESS_RANGE_STATUS BT_MESH_MODEL_OP_2(0x82, 0x58)
#define BT_MESH_MODEL_LIGHT_LIGHTNESS_RANGE_SET BT_MESH_MODEL_OP_2(0x82, 0x5B)
#define BT_MESH_MODEL_LIGHT_LIGHTNESS_RANGE_SET_UNACK BT_MESH_MODEL_OP_2(0x82, 0x5C)
#define BT_MESH_MODEL_LIGHT_LIGHTNESS_RANGE_GET BT_MESH_MODEL_OP_2(0x82, 0x57)

// DEFAULT MESSAGES
#define BT_MESH_MODEL_LIGHT_LIGHTNESS_DEFAULT_SET BT_MESH_MODEL_OP_2(0x82, 0x59)
#define BT_MESH_MODEL_LIGHT_LIGHTNESS_DEFAULT_SET_UNACK BT_MESH_MODEL_OP_2(0x82, 0x5A)
#define BT_MESH_MODEL_LIGHT_LIGHTNESS_DEFAULT_STATUS BT_MESH_MODEL_OP_2(0x82, 0x56)
#define BT_MESH_MODEL_LIGHT_LIGHTNESS_DEFAULT_GET BT_MESH_MODEL_OP_2(0x82, 0x55)

// LAST MESSAGES
#define BT_MESH_MODEL_LIGHT_LIGHTNESS_LAST_STATUS BT_MESH_MODEL_OP_2(0x82, 0x54)
#define BT_MESH_MODEL_LIGHT_LIGHTNESS_LAST_GET BT_MESH_MODEL_OP_2(0x82, 0x53)

extern const struct bt_mesh_model_op light_lightness_srv_op[];
extern const struct bt_mesh_model_op light_lightness_setup_srv_op[];

void light_lightness_default_get(struct bt_mesh_model *model, struct bt_mesh_msg_ctx *ctx,
                                 struct net_buf_simple *buf);
void light_lightness_default_set(struct bt_mesh_model *model, struct bt_mesh_msg_ctx *ctx,
                                 struct net_buf_simple *buf);
void light_lightness_default_set_unack(struct bt_mesh_model *model, struct bt_mesh_msg_ctx *ctx,
                                       struct net_buf_simple *buf);

void light_lightness_range_get(struct bt_mesh_model *model, struct bt_mesh_msg_ctx *ctx,
                               struct net_buf_simple *buf);
void light_lightness_range_set(struct bt_mesh_model *model, struct bt_mesh_msg_ctx *ctx,
                               struct net_buf_simple *buf);
void light_lightness_range_set_unack(struct bt_mesh_model *model, struct bt_mesh_msg_ctx *ctx,
                                     struct net_buf_simple *buf);


void light_lightness_actual_get(struct bt_mesh_model *model, struct bt_mesh_msg_ctx *ctx,
                                struct net_buf_simple *buf);

void light_lightness_actual_set_unack(struct bt_mesh_model *model, struct bt_mesh_msg_ctx *ctx,
                                      struct net_buf_simple *buf);

void light_lightness_actual_set(struct bt_mesh_model *model, struct bt_mesh_msg_ctx *ctx,
                                struct net_buf_simple *buf);


void light_lightness_linear_get(struct bt_mesh_model *model, struct bt_mesh_msg_ctx *ctx,
                                struct net_buf_simple *buf);

void light_lightness_linear_set_unack(struct bt_mesh_model *model, struct bt_mesh_msg_ctx *ctx,
                                      struct net_buf_simple *buf);

void light_lightness_linear_set(struct bt_mesh_model *model, struct bt_mesh_msg_ctx *ctx,
                                struct net_buf_simple *buf);


void light_lightness_last_get(struct bt_mesh_model *model, struct bt_mesh_msg_ctx *ctx,
                              struct net_buf_simple *buf);


#endif
```

## include/bt_mesh.h
```c
/**
 * @file mesh.h
 * @brief
 * @author Lucas Peixoto (lucaspeixotoac@gmail.com)
 * @version 0.1
 * @date 2019-03-06
 */

#ifndef _MESH_H_
#define _MESH_H_

#include <bluetooth/bluetooth.h>
#include <bluetooth/mesh.h>
#include <settings/settings.h>

#include "node_composition.h"

void bt_ready(int err);

#endif
```

## include/firmware_version.h
```c
/**
 * @file firmware_version.h
 * @brief
 * @author Lucas Peixoto (lucaspeixotoac@gmail.com)
 * @version 0.1
 * @date 2019-03-06
 */


#ifndef _FIRMWARE_VERSION_H_
#define _FIRMWARE_VERSION_H_

#include <zephyr/types.h>

#include "current_version.h"


typedef struct {
    u8_t major;
    u8_t minor;
    u16_t build;
} version_t;

const version_t *version_instance();
u8_t version_get_major();
u8_t version_get_minor();
u16_t version_get_build();

#endif
```

## include/light_lightness_state.h
```c
/**
 * @file light_lightness_state.h
 * @Lucas Peixoto (lucaspeixotoac@gmail.com)
 * @brief
 * @version 0.1
 * @date 2019-03-13
 *
 * @copyright Copyright (c) 2019
 *
 */

#ifndef _LIGHT_LIGHTNESS_STATE_H
#define _LIGHT_LIGHTNESS_STATE_H

#include <zephyr/types.h>

#define MINDIFF 2.25e-308
#define LIGHT_OFF 0x0000

#define U16_MAX 0xFFFF
#define U16_MIN 0x0000
#define U16_NULL 0x0000

typedef int (*set_attribute_t)(u16_t x, u16_t y, u16_t message_type);

struct light_lightness_state {
    u16_t linear;
    u16_t target_linear;

    u16_t actual;
    u16_t target_actual;

    u16_t last;
    u16_t def;

    u8_t status_code;
    u16_t range_min;
    u16_t range_max;
    u32_t lightness_range;

    u8_t last_tid;
    u16_t last_src_addr;
    u16_t last_dst_addr;
    s64_t last_msg_timestamp;
    set_attribute_t set_attribute;
};

extern struct light_lightness_state light_lightness_state_data;

#endif
```

## include/mesh.h
```c
/**
 * @file mesh.h
 * @brief
 * @author Lucas Peixoto (lucaspeixotoac@gmail.com)
 * @version 0.1
 * @date 2019-03-06
 */

#ifndef _MESH_H_
#define _MESH_H_

#include <bluetooth/bluetooth.h>
#include <bluetooth/mesh.h>
#include <settings/settings.h>

#include "node_composition.h"

#define BT_MESH_MODEL_LIGHT_LIGHTNESS_STATUS BT_MESH_MODEL_OP_2(0x82, 0x4E)

// LINEAR MESSAGES
#define BT_MESH_MODEL_LIGHT_LIGHTNESS_LINEAR_STATUS BT_MESH_MODEL_OP_2(0x82, 0x52)

// ACTUAL MESSAGES

// RANGE MESSAGES
#define BT_MESH_MODEL_LIGHT_LIGHTNESS_RANGE_STATUS BT_MESH_MODEL_OP_2(0x82, 0x58)
#define BT_MESH_MODEL_LIGHT_LIGHTNESS_RANGE_SET BT_MESH_MODEL_OP_2(0x82, 0x5B)
#define BT_MESH_MODEL_LIGHT_LIGHTNESS_RANGE_SET_UNACK BT_MESH_MODEL_OP_2(0x82, 0x5C)

// DEFAULT MESSAGES
#define BT_MESH_MODEL_LIGHT_LIGHTNESS_DEFAULT_SET BT_MESH_MODEL_OP_2(0x82, 0x59)
#define BT_MESH_MODEL_LIGHT_LIGHTNESS_DEFAULT_SET_UNACK BT_MESH_MODEL_OP_2(0x82, 0x5A)
#define BT_MESH_MODEL_LIGHT_LIGHTNESS_DEFAULT_STATUS BT_MESH_MODEL_OP_2(0x82, 0x56)

// LAST MESSAGES
#define BT_MESH_MODEL_LIGHT_LIGHTNESS_LAST_STATUS BT_MESH_MODEL_OP_2(0x82, 0x54)


//

const struct bt_mesh_comp prov;

void bt_ready(int err);

#endif
```

## include/node_composition.h
```c
/**
 * @file node_composition.h
 * @brief
 * @author Lucas Peixoto (lucaspeixotoac@gmail.com)
 * @version 0.1
 * @date 2019-03-06
 */

#ifndef _NODE_COMPOSITION_H_
#define _NODE_COMPOSITION_H_


#include "mesh.h"
#include "node_composition.h"
#include "transition.h"

extern struct bt_mesh_model root_models[];
extern struct bt_mesh_model node_models[];

extern const struct bt_mesh_comp comp;

#endif
```

## include/pwm_driver.h
```c
#ifndef _PWM_DRIVER_H_
#define _PWM_DRIVER_H_

#include <device.h>
#include <gpio.h>
#include <pwm.h>
#include <zephyr/types.h>

#define PWM_DRIVER DT_NORDIC_NRF_PWM_PWM_0_LABEL

#define PWM_CHANNEL0 LED0_GPIO_PIN

#define PERIOD 20  // 50kHz
#define FADESTEP 2

typedef struct {
    u8_t pin;
    u16_t pulse_width;
    u16_t period;
    u8_t initiated;
    struct device *dev;

} pwm_driver_t;

extern pwm_driver_t pwm;

int init_pwm_driver(pwm_driver_t *pwm, const char *pwm_label, u8_t pin, u16_t period);
int change_pulse_width(pwm_driver_t *pwm, u16_t pulse_width);
int set_pulse_width(pwm_driver_t *pwm);
void blink_light(pwm_driver_t *pwm_driver, u32_t number);

#endif
```

## include/transition.h
```c
/**
 * @file transition.h
 * @brief
 * @author Lucas Peixoto (lucaspeixotoac@gmail.com)
 * @version 0.1
 * @date 2019-03-06
 */

#ifndef _TRANSITION_H_
#define _TRANSITION_H_

#endif
```

## src/bt_callbacks.c
```c
#include "bt_callbacks.h"

#include <logging/log.h>

#include "light_lightness_state.h"
#include "pwm_driver.h"


LOG_MODULE_REGISTER(BT_CALLBACKS, 4);

// Operations
const struct bt_mesh_model_op light_lightness_srv_op[] = {
    {BT_MESH_MODEL_LIGHT_LIGHTNESS_ACTUAL_GET, 0, light_lightness_actual_get},
    {BT_MESH_MODEL_LIGHT_LIGHTNESS_ACTUAL_SET, 3, light_lightness_actual_set},
    {BT_MESH_MODEL_LIGHT_LIGHTNESS_ACTUAL_SET_UNACK, 3, light_lightness_actual_set_unack},
    {BT_MESH_MODEL_LIGHT_LIGHTNESS_LINEAR_GET, 0, light_lightness_linear_get},
    {BT_MESH_MODEL_LIGHT_LIGHTNESS_LINEAR_SET, 3, light_lightness_linear_set},
    {BT_MESH_MODEL_LIGHT_LIGHTNESS_LINEAR_SET_UNACK, 3, light_lightness_linear_set_unack},
    {BT_MESH_MODEL_LIGHT_LIGHTNESS_DEFAULT_GET, 0, light_lightness_default_get},
    {BT_MESH_MODEL_LIGHT_LIGHTNESS_RANGE_GET, 0, light_lightness_range_get},
    {BT_MESH_MODEL_LIGHT_LIGHTNESS_LAST_GET, 0, light_lightness_last_get},
    BT_MESH_MODEL_OP_END,
};

const struct bt_mesh_model_op light_lightness_setup_srv_op[] = {
    {BT_MESH_MODEL_LIGHT_LIGHTNESS_DEFAULT_SET, 2, light_lightness_default_set},
    {BT_MESH_MODEL_LIGHT_LIGHTNESS_DEFAULT_SET_UNACK, 2, light_lightness_default_set_unack},
    {BT_MESH_MODEL_LIGHT_LIGHTNESS_RANGE_SET, 5, light_lightness_range_set},
    {BT_MESH_MODEL_LIGHT_LIGHTNESS_RANGE_SET_UNACK, 5, light_lightness_range_set_unack},
    BT_MESH_MODEL_OP_END,
};

u16_t actual_to_pulse_width(u16_t actual)
{
    return (u16_t)((actual - U16_MIN) * (PERIOD - 0) / (U16_MAX - U16_MIN) + 0);
}

void light_lightness_linear_broadcast(struct bt_mesh_model *model)
{
    int err;
    struct net_buf_simple *msg          = model->pub->msg;
    struct light_lightness_state *state = model->user_data;

    bt_mesh_model_msg_init(msg, BT_MESH_MODEL_LIGHT_LIGHTNESS_LINEAR_STATUS);
    net_buf_simple_add_le16(msg, state->linear);

    err = bt_mesh_model_publish(model);
    if (err) {
        LOG_ERR("bt_mesh_model_publish err %d, sending msg to 0x%04x\n", err, model->pub->addr);
    } else {
        LOG_INF("[0x%04x]: Broadcasting linear state: 0x%04x", bt_mesh_model_elem(model)->addr,
                state->linear);
    }
}


void light_lightness_linear_get(struct bt_mesh_model *model, struct bt_mesh_msg_ctx *ctx,
                                struct net_buf_simple *buf)
{
    LOG_INF("[LINEAR_GET - 0x%04x]: Received a get msg from group address 0x%04x, sent by 0x%04x",
            bt_mesh_model_elem(model)->addr, ctx->recv_dst, ctx->addr);
    struct light_lightness_state *state = model->user_data;
    struct net_buf_simple *msg          = NET_BUF_SIMPLE(2 + 5 + 4);

    bt_mesh_model_msg_init(msg, BT_MESH_MODEL_LIGHT_LIGHTNESS_LINEAR_STATUS);
    net_buf_simple_add_le16(msg, state->linear);

    if (bt_mesh_model_send(model, ctx, msg, NULL, NULL)) {
        printk("Unable to send LightLightnessAct Status response\n");
    } else {
        LOG_INF("[LINEAR_GET - 0x%04x]: status msg value 0x%04x will be send to 0x%04x",
                bt_mesh_model_elem(model)->addr, state->linear, ctx->addr);
    }
}

void light_lightness_linear_set_unack(struct bt_mesh_model *model, struct bt_mesh_msg_ctx *ctx,
                                      struct net_buf_simple *buf)
{
    LOG_INF("[LINEAR_SET - 0x%04x]: Received a set msg from group address 0x%04x, sent by 0x%04x",
            bt_mesh_model_elem(model)->addr, ctx->recv_dst, ctx->addr);

    struct light_lightness_state *state = model->user_data;
    u16_t lightness                     = net_buf_simple_pull_le16(buf);
    u8_t tid                            = net_buf_simple_pull_u8(buf);


    s64_t now = k_uptime_get();
    if (state->last_tid == tid && state->last_src_addr == ctx->addr
        && state->last_dst_addr == ctx->recv_dst
        && (now - state->last_msg_timestamp <= K_SECONDS(6))) {
        return;
    }

    /*blink_light(&pwm, 3);*/

    state->last_tid           = tid;
    state->last_src_addr      = ctx->addr;
    state->last_dst_addr      = ctx->recv_dst;
    state->last_msg_timestamp = now;

    LOG_INF("[LINEAR_SET - 0x%04x]: Value msg: 0x%04x\n", bt_mesh_model_elem(model)->addr,
            lightness);

    if (state->set_attribute(lightness, U16_NULL, BT_MESH_MODEL_LIGHT_LIGHTNESS_LINEAR_SET_UNACK)) {
        LOG_INF("Invalid lightness");
    } else {
        change_pulse_width(&pwm, actual_to_pulse_width(state->actual));
        set_pulse_width(&pwm);
        light_lightness_last_get(model, ctx, buf);
    }
}

void light_lightness_linear_set(struct bt_mesh_model *model, struct bt_mesh_msg_ctx *ctx,
                                struct net_buf_simple *buf)
{
    light_lightness_linear_set_unack(model, ctx, buf);
    light_lightness_linear_get(model, ctx, buf);
    light_lightness_linear_broadcast(model);
}


void light_lightness_actual_broadcast(struct bt_mesh_model *model)
{
    int err;
    struct net_buf_simple *msg          = model->pub->msg;
    struct light_lightness_state *state = model->user_data;

    bt_mesh_model_msg_init(msg, BT_MESH_MODEL_LIGHT_LIGHTNESS_ACTUAL_STATUS);
    net_buf_simple_add_le16(msg, state->actual);

    err = bt_mesh_model_publish(model);
    if (err) {
        LOG_ERR("bt_mesh_model_publish err %d, sending msg to 0x%04x\n", err, model->pub->addr);
    } else {
        LOG_INF("[ACTUAL_SET - 0x%04x]: Broadcasting actual state: 0x%04x",
                bt_mesh_model_elem(model)->addr, state->actual);
    }
}

void light_lightness_actual_get(struct bt_mesh_model *model, struct bt_mesh_msg_ctx *ctx,
                                struct net_buf_simple *buf)
{
    LOG_INF("[ACTUAL_GET - 0x%04x]: Received a get msg from group address 0x%04x, sent by 0x%04x",
            bt_mesh_model_elem(model)->addr, ctx->recv_dst, ctx->addr);
    struct net_buf_simple *msg          = NET_BUF_SIMPLE(2 + 5 + 4);
    struct light_lightness_state *state = model->user_data;

    printk("0x%04x \n", model->pub->addr);

    bt_mesh_model_msg_init(msg, BT_MESH_MODEL_LIGHT_LIGHTNESS_ACTUAL_STATUS);
    net_buf_simple_add_le16(msg, state->actual);

    if (bt_mesh_model_send(model, ctx, msg, NULL, NULL)) {
        printk("Unable to send LightLightnessAct Status response\n");
    } else {
        LOG_INF("[ACTUAL_GET - 0x%04x]: status msg value 0x%04x will be send to 0x%04x",
                bt_mesh_model_elem(model)->addr, state->actual, ctx->addr);
    }
}

void light_lightness_actual_set_unack(struct bt_mesh_model *model, struct bt_mesh_msg_ctx *ctx,
                                      struct net_buf_simple *buf)
{
    LOG_INF("[ACTUAL_SET - 0x%04x]: Received a set msg from group address 0x%04x, sent by 0x%04x",
            bt_mesh_model_elem(model)->addr, ctx->recv_dst, ctx->addr);

    struct light_lightness_state *state = model->user_data;
    s64_t now;
    u8_t tid;
    u16_t lightness = net_buf_simple_pull_le16(buf);
    tid             = net_buf_simple_pull_u8(buf);

    now = k_uptime_get();
    if (state->last_tid == tid && state->last_src_addr == ctx->addr
        && state->last_dst_addr == ctx->recv_dst
        && (now - state->last_msg_timestamp <= K_SECONDS(6))) {
        return;
    }

    state->last_tid           = tid;
    state->last_src_addr      = ctx->addr;
    state->last_dst_addr      = ctx->recv_dst;
    state->last_msg_timestamp = now;
    LOG_INF("[ACTUAL_SET - 0x%04x]: Value msg: 0x%04x\n", bt_mesh_model_elem(model)->addr,
            lightness);

    if (state->set_attribute(lightness, U16_NULL, BT_MESH_MODEL_LIGHT_LIGHTNESS_ACTUAL_SET_UNACK)) {
        LOG_INF("Invalid lightness");
    } else {
        change_pulse_width(&pwm, actual_to_pulse_width(state->actual));
        set_pulse_width(&pwm);
    }
}

void light_lightness_actual_set(struct bt_mesh_model *model, struct bt_mesh_msg_ctx *ctx,
                                struct net_buf_simple *buf)
{
    light_lightness_actual_set_unack(model, ctx, buf);
    light_lightness_actual_get(model, ctx, buf);
    light_lightness_actual_broadcast(model);
}


void light_lightness_default_get(struct bt_mesh_model *model, struct bt_mesh_msg_ctx *ctx,
                                 struct net_buf_simple *buf)
{
    LOG_INF("[DEFAULT_GET - 0x%04x]: Received a get msg from group address 0x%04x, sent by 0x%04x",
            bt_mesh_model_elem(model)->addr, ctx->recv_dst, ctx->addr);
    struct bt_mesh_model_pub *pub;
    pub                                 = model->pub;
    struct light_lightness_state *state = model->user_data;

    bt_mesh_model_msg_init(pub->msg, BT_MESH_MODEL_LIGHT_LIGHTNESS_DEFAULT_STATUS);
    net_buf_simple_add_le16(pub->msg, state->def);

    if (bt_mesh_model_send(model, ctx, pub->msg, NULL, NULL)) {
        printk("Unable to send LightLightnessDef Status response\n");
    } else {
        LOG_INF("[DEFAULT_GET - 0x%04x]: status msg value 0x%04x will be send to 0x%04x",
                bt_mesh_model_elem(model)->addr, state->def, ctx->addr);
    }
}

void light_lightness_default_set(struct bt_mesh_model *model, struct bt_mesh_msg_ctx *ctx,
                                 struct net_buf_simple *buf)
{
    light_lightness_default_set_unack(model, ctx, buf);
    light_lightness_default_get(model, ctx, buf);
    int err = bt_mesh_model_publish(model);
    if (err) {
        printk("bt_mesh_model_publish err %d, sending msg to 0x%04x\n", err, model->pub->addr);
    } else {
        LOG_INF("[DEFAULT_SET - 0x%04x]: Broadcasting...", bt_mesh_model_elem(model)->addr);
    }
}

void light_lightness_default_set_unack(struct bt_mesh_model *model, struct bt_mesh_msg_ctx *ctx,
                                       struct net_buf_simple *buf)
{
    LOG_INF("[DEFAULT_SET - 0x%04x]: Received a set msg from group address 0x%04x, sent by 0x%04x",
            bt_mesh_model_elem(model)->addr, ctx->recv_dst, ctx->addr);
    u16_t lightness;
    struct light_lightness_state *state = model->user_data;

    lightness = net_buf_simple_pull_le16(buf);

    state->def = lightness;
}


void light_lightness_range_get(struct bt_mesh_model *model, struct bt_mesh_msg_ctx *ctx,
                               struct net_buf_simple *buf)
{
    LOG_INF("[RANGE_GET - 0x%04x]: Received a get msg from group address 0x%04x, sent by 0x%04x",
            bt_mesh_model_elem(model)->addr, ctx->recv_dst, ctx->addr);
    struct bt_mesh_model_pub *pub;
    pub                                 = model->pub;
    struct light_lightness_state *state = model->user_data;

    bt_mesh_model_msg_init(pub->msg, BT_MESH_MODEL_LIGHT_LIGHTNESS_RANGE_STATUS);
    net_buf_simple_add_u8(pub->msg, state->status_code);
    net_buf_simple_add_le16(pub->msg, state->range_min);
    net_buf_simple_add_le16(pub->msg, state->range_max);

    if (bt_mesh_model_send(model, ctx, pub->msg, NULL, NULL)) {
        printk("Unable to send LightLightnessRange Status response\n");
    } else {
        LOG_INF("[RANGE_GET - 0x%04x]: Value msg: 0x%04x/0x%04x will be send to 0x%04x",
                bt_mesh_model_elem(model)->addr, state->range_min, state->range_max, ctx->addr);
    }
}

void light_lightness_range_set(struct bt_mesh_model *model, struct bt_mesh_msg_ctx *ctx,
                               struct net_buf_simple *buf)
{
    light_lightness_range_set_unack(model, ctx, buf);
    light_lightness_range_get(model, ctx, buf);
    int err = bt_mesh_model_publish(model);
    if (err) {
        printk("bt_mesh_model_publish err %d, sending msg to 0x%04x\n", err, model->pub->addr);
    } else {
        LOG_INF("[RANGE_SET - 0x%04x]: Broadcasting...", bt_mesh_model_elem(model)->addr);
    }
}

void light_lightness_range_set_unack(struct bt_mesh_model *model, struct bt_mesh_msg_ctx *ctx,
                                     struct net_buf_simple *buf)
{
    u16_t min, max;
    struct light_lightness_state *state = model->user_data;

    min                = net_buf_simple_pull_le16(buf);
    max                = net_buf_simple_pull_le16(buf);
    state->status_code = 0x00;
    if (state->set_attribute(min, max, BT_MESH_MODEL_LIGHT_LIGHTNESS_RANGE_SET_UNACK)) {
        state->status_code = 0x01;
    }
}


void light_lightness_last_get(struct bt_mesh_model *model, struct bt_mesh_msg_ctx *ctx,
                              struct net_buf_simple *buf)
{
    LOG_INF("[LAST_GET - 0x%04x]: Received a get msg from group address 0x%04x, sent by 0x%04x",
            bt_mesh_model_elem(model)->addr, ctx->recv_dst, ctx->addr);
    struct bt_mesh_model_pub *pub;
    pub                                 = model->pub;
    struct light_lightness_state *state = model->user_data;

    bt_mesh_model_msg_init(pub->msg, BT_MESH_MODEL_LIGHT_LIGHTNESS_LAST_STATUS);
    net_buf_simple_add_le16(pub->msg, state->last);

    if (bt_mesh_model_send(model, ctx, pub->msg, NULL, NULL)) {
        printk("Unable to send LightLightnessAct Status response\n");
    } else {
        LOG_INF("[LAST_GET - 0x%04x]: status msg value 0x%04x will be send to 0x%04x",
                bt_mesh_model_elem(model)->addr, state->last, ctx->addr);
    }
}
```

## src/bt_mesh.c
```c
/**
 * @file mesh.c
 * @brief
 * @author Lucas Peixoto (lucaspeixotoac@gmail.com)
 * @version 0.1
 * @date 2019-03-06
 */

#include "bt_mesh.h"

#include <logging/log.h>

#include "pwm_driver.h"

LOG_MODULE_REGISTER(BT_MESH, 4);

static const u8_t dev_uuid[16] = {0xcf, 0xa0, 0xea, 0x7e, 0x17, 0xd9, 0x11, 0xe8,
                                  0x85, 0xd1, 0x5f, 0x1c, 0xe2, 0x8a, 0xde, 0xa7};

static int output_number(bt_mesh_output_action_t action, u32_t number)
{
    LOG_INF("OOB Number: %u\n", number);
    blink_light(&pwm, number);
    LOG_INF("OOB sent\n");
    return 0;
}

static void prov_complete(u16_t net_idx, u16_t addr)
{
}

static void prov_reset(void)
{
    bt_mesh_prov_enable(BT_MESH_PROV_ADV | BT_MESH_PROV_GATT);
}

static const struct bt_mesh_prov prov = {
    .uuid           = dev_uuid,
    .output_size    = 1,
    .output_actions = BT_MESH_DISPLAY_NUMBER,
    .output_number  = output_number,
    .complete       = prov_complete,
    .reset          = prov_reset,
};

void bt_ready(int err)
{
    if (err) {
        LOG_INF("bt_enable init failed with err %d\n", err);
        return;
    }

    LOG_INF("Bluetooth initialized.\n");
    err = bt_mesh_init(&prov, &comp);
    if (err) {
        LOG_INF("bt_mesh init failed with err %d\n", err);
        return;
    }

    if (IS_ENABLED(CONFIG_BT_SETTINGS)) {
        settings_load();
    }

    /* This will be a no-op if settings_load() loaded provisioning info */
    bt_mesh_prov_enable(BT_MESH_PROV_ADV | BT_MESH_PROV_GATT);
    LOG_INF("Mesh initialized.\n");
}
```

## src/firmware_version.c
```c
/**
 * @file firmware_version.c
 * @brief
 * @author Lucas Peixoto (lucaspeixotoac@gmail.com)
 * @version 0.1
 * @date 2019-03-06
 */

#include "firmware_version.h"


static const version_t __version = {VERSION_MAJOR, VERSION_MINOR, VERSION_BUILD};

const version_t *version_instance()
{
    return &__version;
}

u8_t version_get_major()
{
    return __version.major;
}

u8_t version_get_minor()
{
    return __version.minor;
}
u16_t version_get_build()
{
    return __version.build;
}
```

## src/light_lightness_state.c
```c
#include "light_lightness_state.h"

#include "bt_callbacks.h"

static float sqrt(float square)
{
    float root, last, diff;

    root = square / 3.0;
    diff = 1;

    if (square <= 0) {
        return 0;
    }

    do {
        last = root;
        root = (root + square / root) / 2.0;
        diff = root - last;
    } while (diff > MINDIFF || diff < -MINDIFF);

    return root;
}

static s32_t ceiling(float num)
{
    s32_t inum;

    inum = (s32_t) num;
    if (num == (float) inum) {
        return inum;
    }

    return inum + 1;
}

static u16_t actual_to_linear(u16_t actual)
{
    float tmp;

    tmp = ((float) actual / 65535);

    return (u16_t) ceiling(65535 * tmp * tmp);
}

static u16_t linear_to_actual(u16_t linear)
{
    return (u16_t)(65535 * sqrt(((float) linear / 65535)));
}


int set_attribute(u16_t x, u16_t y, u16_t message_type)
{
    int err = 0;
    ;
    switch (message_type) {
    case BT_MESH_MODEL_LIGHT_LIGHTNESS_ACTUAL_SET_UNACK:
        if ((x >= light_lightness_state_data.range_min && x <= light_lightness_state_data.range_max)
            || x == LIGHT_OFF) {
            if (light_lightness_state_data.actual) {
                light_lightness_state_data.last = light_lightness_state_data.actual;
            }
            light_lightness_state_data.actual = x;
            light_lightness_state_data.linear = actual_to_linear(x);
        } else {
            err = -EINVAL;
        }
        break;
    case BT_MESH_MODEL_LIGHT_LIGHTNESS_LINEAR_SET_UNACK:
        if ((x >= light_lightness_state_data.range_min && x <= light_lightness_state_data.range_max)
            || x == LIGHT_OFF) {
            if (light_lightness_state_data.actual) {
                light_lightness_state_data.last = light_lightness_state_data.actual;
            }
            light_lightness_state_data.linear = x;
            light_lightness_state_data.actual = linear_to_actual(x);
        } else {
            err = -EINVAL;
        }
        break;
    case BT_MESH_MODEL_LIGHT_LIGHTNESS_RANGE_SET_UNACK:
        if (x != 0 && y != 0) {
            if (x <= y) {
                if (light_lightness_state_data.range_min != x
                    || light_lightness_state_data.range_max != y) {
                    light_lightness_state_data.range_min = x;
                    light_lightness_state_data.range_max = y;
                }
            } else {
                err = -EINVAL;
            }
        } else {
            err = -EINVAL;
        }
    default:
        break;
    };
    return 0;
}

struct light_lightness_state light_lightness_state_data = {
    .set_attribute = set_attribute,
    .actual        = 0x0000,
    .linear        = 0x0000,
    .last          = 0xFFFF,
    .range_max     = U16_MAX,
    .range_min     = 0x0001,
    .def           = 0x0000,
    .status_code   = 0x00,
};
```
